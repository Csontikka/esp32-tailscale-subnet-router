## sdkconfig.defaults
```kconfig
# Project-wide defaults. PlatformIO + ESP-IDF both honour this file.
#
# Most of the values here were tuned by trial and error on the previous
# private fork; the comments mark which knob mattered and why so that
# anyone reading the config later doesn't have to repeat the discovery.

# --- Flash / partitions -----------------------------------------------------
CONFIG_ESPTOOLPY_FLASHSIZE_4MB=y
CONFIG_ESPTOOLPY_FLASHSIZE="4MB"
CONFIG_PARTITION_TABLE_CUSTOM=y
CONFIG_PARTITION_TABLE_CUSTOM_FILENAME="partitions.csv"
CONFIG_PARTITION_TABLE_FILENAME="partitions.csv"

# --- CPU / PSRAM (ESP32-S3 N16R8 reference board) ---------------------------
CONFIG_ESP_DEFAULT_CPU_FREQ_MHZ_240=y
CONFIG_SPIRAM=y
CONFIG_SPIRAM_MODE_OCT=y
CONFIG_SPIRAM_SPEED_80M=y
CONFIG_SPIRAM_BOOT_HW_INIT=y

# Let WiFi & lwIP buffers spill to SPIRAM under internal-heap pressure.
# Without this, the tail end of a WG TX burst hits pbuf_alloc(PBUF_RAM)
# failures (ERR_MEM, -1) on the magicsock path while there's 8 MB of
# SPIRAM sitting idle. With it enabled and the SPIRAM custom-pbuf path
# in ml_wg_mgr.c the per-packet drop rate dropped from ~5.7/s to ~0/s.
CONFIG_SPIRAM_TRY_ALLOCATE_WIFI_LWIP=y

# Push medium generic-malloc allocations to SPIRAM to relieve the tight
# internal DRAM (idle ~57K free, ~35K low-water under load — confirmed via
# the SD-recorder idram instrument). Default 16384 keeps everything <16K
# internal; 4096 lets 4–16K allocations (HTTP bodies, JSON, medium buffers)
# land in the 8 MB SPIRAM instead. DMA / explicitly-internal allocations are
# unaffected (they use MALLOC_CAP_DMA/INTERNAL); RESERVE_INTERNAL=32768 keeps
# the DMA headroom. Hot/small allocations still stay internal.
CONFIG_SPIRAM_MALLOC_ALWAYSINTERNAL=4096

# --- Main task: more stack than the default 3584 ----------------------------
# Several boot-time init paths (microlink_init, http_server start, NAPT
# setup) push into the same task. 7 KB keeps the canary intact.
CONFIG_ESP_MAIN_TASK_STACK_SIZE=7168

# --- Bootloader verbosity ---------------------------------------------------
CONFIG_BOOTLOADER_LOG_LEVEL_WARN=y
CONFIG_BOOTLOADER_LOG_LEVEL=2

# --- Runtime log verbosity (2026-05-24 throughput hunt) -------------------
# Compile out every ESP_LOGI per-packet log on the WG TX/RX hot path. The
# microlink stack prints multiple INFO lines per packet (WG UDP TX, WG RX,
# DISCO PING/PONG, ml_net_io UDP RX); at 50 pps that's ~200 log lines/s ~=
# 40 KB/s on a 115200-baud UART (~12 KB/s) and ml_wg_mgr blocks while
# pushing them. WARN+ still surfaces every problem we care about (errors,
# session events, my own [WG_SNAP]/[WG_REKEY]/[WG_DESTROY] instrumentation
# are LOGW so they survive). Restore to INFO if you need per-packet trace.
# CONFIG_LOG_DEFAULT_LEVEL_INFO is not set
CONFIG_LOG_DEFAULT_LEVEL_WARN=y
CONFIG_LOG_DEFAULT_LEVEL=2

# Push the UART out of the way: 8x faster console = 8x less time the
# logging task blocks on the UART driver. CH343 USB-serial supports it.
CONFIG_ESP_CONSOLE_UART_BAUDRATE=921600

# --- LWIP: NAPT, IP forwarding, socket budget -------------------------------
CONFIG_LWIP_IP_FORWARD=y
CONFIG_LWIP_IPV4_NAPT=y
CONFIG_LWIP_L2_TO_L3_COPY=y
# 10 (default) gets eaten by http_server + microlink + remote console + DNS
# + ping; the next consumer's socket() fails with EMFILE. 16 was tight for
# normal use; once the AP-side DNS forwarder went default-on and the
# operator started running a 2-minute speedtest cron from a client, peak
# load (Ookla opens 8-16 parallel TCP streams + DNS forwarder + telemetry
# + WG + DERP + 2 httpd pools) blew past 16 and httpd logged
# "httpd_accept_conn: error in accept (23)" — errno 23 = ENFILE. Up to 24.
CONFIG_LWIP_MAX_SOCKETS=24
# 2026-05-24 throughput-regression bisect: comparing the migration target
# sdkconfig against the pre-migration OLD repo (which delivered the
# expected 1 Mbps WG-tunnel throughput) showed the NEW config aggressively
# tuned several lwIP/WiFi knobs that, in isolation, look like
# performance wins — but together they push the internal heap into a
# pressure regime where mem_malloc(PBUF_RAM) starts returning NULL on
# the WG TX hot path. Each failed alloc drops a packet; even a handful
# of drops over a 30 s Ookla run cause cascading TCP back-off and the
# user-visible throughput collapses to ~10-20 KB/s.
#
# Reverted to IDF defaults (matching the OLD repo) — see those tuning
# values in commit history if a future measurement says they're worth
# re-trying one at a time WITH instrumentation:
#   CONFIG_LWIP_TCP_WND_DEFAULT=32768      (default ~5760)
#   CONFIG_LWIP_TCP_SND_BUF_DEFAULT=32768  (default ~5760)
#
# 2026-05-24 bisect step 1: now that the channel-mismatch masking bug
# is fixed (ap_chan_learned in main.c) and WiFi/lwIP buffers can spill
# to SPIRAM (SPIRAM_TRY_ALLOCATE_WIFI_LWIP=y), re-enable RX-side AMPDU
# aggregation. Default RX_BA_WIN=6 leaves the radio unable to coalesce
# more than 6 frames per BlockAck, while TX_BA_WIN was already 32;
# mismatched windows can stall AMPDU re-orders. ESP-IDF builds in a
# hard constraint RX_BA_WIN <= 2 * STATIC_RX_BUFFER_NUM (see
# components/esp_wifi/src/wifi_init.c:56), so the two MUST move
# together — 32 needs ≥16, not separable.
#
# 2026-05-24 bisect step 2: STATIC_RX_BUFFER_NUM raised 16→24 to defeat
# the download→upload-stall observed in phone Ookla speedtests. After
# the download phase (AP-TX-heavy), the client opens 8-16 parallel
# upload sockets at once; that SYN-burst arrives as one large AMPDU
# (BA_WIN=32) on the AP-RX path. With only 16 static RX buffers we
# barely fit the burst and any concurrent ARP/DNS/TCP-keepalive frame
# drops, taking the upload SYN(+retx) with it — phone declares the
# upload phase failed. 24 leaves headroom (+~12KB internal heap) for
# co-arriving control traffic. BA_WIN=32 constraint still satisfied
# (≤2*24=48). TCP_WND / TCP_SND_BUF stay default for now.
CONFIG_ESP_WIFI_RX_BA_WIN=32
CONFIG_ESP_WIFI_STATIC_RX_BUFFER_NUM=24

# --- Flash mode — back to DIO after a QIO regression on this board ---------
# Tried CONFIG_ESPTOOLPY_FLASHMODE_QIO=y for the 2× code-fetch win, the
# build booted fine on the dev module, but a real phone STA started
# losing connectivity to the AP under live use. No PANIC, no syslog
# marker — symptom was speedtest-fail + occasional deauth. Could be
# the QIO timing margin on this exact board variant. DIO is the boring
# safe default; revisit when there's a way to A/B without disrupting
# the operator.
CONFIG_ESPTOOLPY_FLASHMODE_DIO=y
CONFIG_ESPTOOLPY_FLASHMODE="dio"

# --- TCP window scaling (RFC 1323) ------------------------------------------
# Lets receive windows grow past 64 KB on long-RTT paths (DERP relays
# add ~40 ms; the home WiFi route is ~30 ms). Trivial when both peers
# negotiate it; no-op against a peer that doesn't.
CONFIG_LWIP_TCP_RCV_SCALE=2
CONFIG_LWIP_TCP_RECVMBOX_SIZE=12

# --- DHCP server ------------------------------------------------------------
CONFIG_LWIP_DHCPS_MAX_STATION_NUM=16

# --- WiFi tuning ------------------------------------------------------------
CONFIG_ESP_WIFI_DYNAMIC_RX_BUFFER_NUM=48
# 2026-05-26 bisect step 3 (TX analog of step 2): the AP-TX-heavy phone-
# speedtest download (+ cancel/restart churn) exhausted the WiFi TX buffers,
# failing sends with ENOMEM (errno 12) while ~35 KB internal heap was STILL
# free — a count cap, not heap exhaustion (confirmed via the SD-recorder
# idram instrument). TX cannot go dynamic here: CONFIG_ESP_WIFI_DYNAMIC_TX_
# BUFFER is Kconfig-forbidden when SPIRAM_TRY_ALLOCATE_WIFI_LWIP=y (with PSRAM
# the TX path must be static). The SPIRAM-backed spill IS the CACHE TX queue:
# when the 16 static (DMA) TX buffers are full, the driver caches the packet
# in SPIRAM instead of dropping it with ENOMEM. Raise that queue 32→96 to
# absorb the burst in SPIRAM (plentiful) rather than the tight internal DRAM.
# (DYNAMIC_TX_BUFFER_NUM stays but is inert while TX is static.)
CONFIG_ESP_WIFI_DYNAMIC_TX_BUFFER_NUM=48
CONFIG_ESP_WIFI_CACHE_TX_BUFFER_NUM=96
CONFIG_ESP_WIFI_AMPDU_TX_ENABLED=y
CONFIG_ESP_WIFI_AMPDU_RX_ENABLED=y
CONFIG_ESP_WIFI_TX_BA_WIN=32
# AMSDU TX aggregation cuts per-frame overhead on the AP-to-client leg
CONFIG_ESP_WIFI_AMSDU_TX_ENABLED=y

# --- mbedTLS: cert bundle + PSRAM allocator ---------------------------------
# Cert bundle is needed to validate *.workers.dev (and any other public
# HTTPS endpoint) without shipping the certificates ourselves.
CONFIG_MBEDTLS_CERTIFICATE_BUNDLE=y
CONFIG_MBEDTLS_CERTIFICATE_BUNDLE_DEFAULT_FULL=y
# mbedTLS allocations target internal RAM by default; with microlink +
# wireguard running, each SSL session's ~20 KB IN+OUT buffers fail to
# find a contiguous block (MBEDTLS_ERR_SSL_ALLOC_FAILED, -0x7F00).
# Spill to PSRAM — 8 MB of headroom solves it.
CONFIG_MBEDTLS_EXTERNAL_MEM_ALLOC=y
# microlink's Noise handshake needs ChaCha20-Poly1305.
CONFIG_MBEDTLS_CHACHA20_C=y
CONFIG_MBEDTLS_POLY1305_C=y
CONFIG_MBEDTLS_CHACHAPOLY_C=y

# --- ESP-IDF v5.5 sys_evt task stack ----------------------------------------
# Default 2304 B overflows on the STA reconnect path (chained callbacks
# through syslog/tailscale/AP-event handlers); bump to match TCPIP
# task headroom.
CONFIG_ESP_SYSTEM_EVENT_TASK_STACK_SIZE=6144

# --- LwIP TCPIP task stack --------------------------------------------------
# Default 3072 B overflows when an AP client's first DHCP exchange runs
# through our two --wrap'd lwIP hooks (ip_napt_forward + ip4_route_src_hook)
# on top of the microlink WG ingress path that's already on the tiT task.
# Repro after factory_reset → boot → Pi joins AP → DHCP DISCOVER → PANIC
# in the tiT task with vApplicationStackOverflowHook in the backtrace
# (decoded via xtensa-esp32s3-elf-addr2line on the captured crash one-liner).
# 6 KB matches the sys_evt bump above and gives the wrap callbacks
# enough headroom for nested netif input/output paths.
CONFIG_LWIP_TCPIP_TASK_STACK_SIZE=6144

# --- Coredump to flash ------------------------------------------------------
# After a PANIC/WDT the kernel writes a full backtrace + task state to
# the dedicated "coredump" partition so the next boot can surface it
# via esp_core_dump_image_get + summary.
# CONFIG_ESP_COREDUMP_ENABLE_TO_NONE is not set
CONFIG_ESP_COREDUMP_ENABLE_TO_FLASH=y
CONFIG_ESP_COREDUMP_DATA_FORMAT_ELF=y
CONFIG_ESP_COREDUMP_CHECKSUM_CRC32=y

# --- Compiler ---------------------------------------------------------------
# Perf opt buys ~10-15% tunnel throughput on the WG userspace stack
# (ChaCha20-Poly1305 is CPU-bound on S3) at the cost of ~50-100 KB
# binary growth — fine within 4 MB flash.
# CONFIG_COMPILER_OPTIMIZATION_SIZE is not set
CONFIG_COMPILER_OPTIMIZATION_PERF=y

# --- OTA --------------------------------------------------------------------
CONFIG_BOOTLOADER_APP_ROLLBACK_ENABLE=y

# --- FreeRTOS extras for the 'tasks' CLI command ---------------------------
CONFIG_FREERTOS_USE_TRACE_FACILITY=y
CONFIG_FREERTOS_USE_STATS_FORMATTING_FUNCTIONS=y
# Per-task runtime counters — needed by /api/status to compute live CPU %
# from the IDLE0+IDLE1 task fractions. Overhead is one esp_timer read per
# context switch (~0.5 % CPU on the S3 at standard load).
CONFIG_FREERTOS_GENERATE_RUN_TIME_STATS=y

# --- HTTPS server removed (2026-05-24) ------------------------------------
# We moved off esp_https_server because the self-signed mbedTLS handshake
# was intermittently failing under load (-0x7780, FATAL_ALERT_MESSAGE)
# and cost ~20 KB heap per active TLS session. The only reason for HTTPS
# in the first place was the WebCrypto SubtleCrypto secure-context
# requirement for encrypted-backup; that's now satisfied by SJCL inlined
# into the SPA (vendor/sjcl.min.js, injected by gen_index_html_gz.py).
# The mbedTLS X509 cert-write flags are dropped with it.
```
